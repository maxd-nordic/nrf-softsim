## west.yml
```yaml
# NCS Workflow 4: Application as the manifest repo
# https://developer.nordicsemi.com/nRF_Connect_SDK/doc/latest/nrf/dm_adding_code.html
manifest:
  remotes:
    - name: t91x
      url-base: https://github.com/bjda-thingy91/
  projects:
    - name: sdk-nrf
      path: nrf
      revision: thingy91x_board_rebase_dec12_cleanup
      remote: t91x
      import: true

  self:
    path: modules/lib/onomondo-softsim
```
